## src/drivers/scd/Kconfig
```kconfig
menuconfig DRIVERS_SCD
	bool "scd"
	default n
	---help---
		Enable support for scd
```

## src/modules/first/Kconfig
```kconfig
menuconfig MODULES_FIRST
	bool "first"
	default n
	---help---
		Enable support for first

menuconfig USER_FIRST
	bool "first running as userspace module"
	default y
	depends on BOARD_PROTECTED && MODULES_FIRST
	---help---
		Put sfirst in userspace memory
```

## src/modules/setpoint_6dof/Kconfig
```kconfig
menuconfig MODULES_SETPOINT_6DOF
	bool "setpoint_6dof"
	default n
	---help---
		Enable support for setpoint_6dof

menuconfig USER_SETPOINT_6DOF
	bool "setpoint_6dof running as userspace module"
	default y
	depends on BOARD_PROTECTED && MODULES_SETPOINT_6DOF
	---help---
		Put setpoint_6dof in userspace memory
```

## src/modules/sk100/Kconfig
```kconfig
menuconfig MODULES_SK100
	bool "sk100"
	default n
	---help---
		Enable support for sk100

menuconfig USER_sk100
	bool "sk100 running as userspace module"
	default y
	depends on BOARD_PROTECTED && MODULES_SK100
	---help---
		Put sk100 in userspace memory
```

## src/modules/steering_engine/Kconfig
```kconfig
menuconfig MODULES_STEERING_ENGINE
	bool "steering_engine"
	default n
	---help---
		Enable support for steering_engine

menuconfig USER_STEERING_ENGINE
	bool "steering_engine running as userspace module"
	default y
	depends on BOARD_PROTECTED && MODULES_STEERING_ENGINE
	---help---
		Put steering_engine in userspace memory
```
